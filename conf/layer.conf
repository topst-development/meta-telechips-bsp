## conf/layer.conf
```bitbake
# We have a conf and classes directory, add to BBPATH
BBPATH .= ":${LAYERDIR}"

# We have a recipes directory containing .bb and .bbappend files, add to BBFILES
BBFILES += "${LAYERDIR}/recipes-*/*/*.bb \
			${LAYERDIR}/recipes-*/*/*.bbappend"

BBFILE_COLLECTIONS += "telechips-bsp"
BBFILE_PATTERN_telechips-bsp = "^${LAYERDIR}/"
BBFILE_PRIORITY_telechips-bsp = "8"

BBMASK += "${@bb.utils.contains('TCC_ARCH_FAMILY', 'tcc897x', '${LAYERDIR}/recipes-bsp/u-boot/u-boot-tcc.bb ${LAYERDIR}/recipes-bsp/boot-firmware/', '${LAYERDIR}/recipes-bsp/lk/lk-dt_1.0.0.bb', d)}"

# This should only be incremented on significant changes that will
# cause compatibility issues with other layers
LAYERVERSION_telechips-bsp = "2"

LAYERDEPENDS_telechips-bsp = "core"
include conf/meta-bsp_doc.conf

LAYERSERIES_COMPAT_telechips-bsp = "kirkstone"
COMPATIBLE_LICENSES:append = " ARM"

IMAGE_FEATURES[validitems] += "uboot-fit"
```

## conf/machine/tcc-family.inc
```bitbake
#@TYPE: Machine
#@NAME: Telechips SOC Family
#@DESCRIPTION: Machine configuration for the Telechips EVM Board

# Ship all kernel modules by default
MACHINE_EXTRA_RRECOMMENDS = "kernel-modules"

DEFAULT_IMAGE_FSTYPE ?= "ext4"
SWITCH_ROOTFS_MOUNT_OPT ?= "-o ro,noatime,noload"
MKUBIFS_ARGS = "--min-io-size 4096 --leb-size 516096 --max-leb-cnt 8139"

TCC_ARCH_FAMILY ?= "${@d.getVar("SOC_FAMILY").split(":")[0]}"
TCC_MACHINE_FAMILY ?= "${TCC_ARCH_FAMILY}-${@d.getVar("SOC_FAMILY").split("-")[-1]}"

MACHINE_FEATURES = "usbgadget usbhost vfat alsa"
MACHINE_FEATURES += "${@oe.utils.conditional('BOOT_STORAGE', 'ufs', 'ufs', 'emmc', d)}"

# initramfs -> pivot root
# default rootfs is initramfs
# If you do not want to use the initramfs,
# you have to set 'INITRAMFS_IMAGE' and 'INITRAMFS_TASK' to NULL("") on your conf/local.conf

INITRAMFS_FSTYPES ?= "cpio"
INITRAMFS_IMAGE ?= "initramfs-telechips-image"
INITRAMFS_IMAGE_BUNDLE = "1"

KERNEL_IMAGETYPES ?= "${@bb.utils.contains('IMAGE_FEATURES', 'uboot-fit', 'fitImage', '', d)}"
KERNEL_CLASSES ?= "${@bb.utils.contains('IMAGE_FEATURES', 'uboot-fit', 'kernel-fitimage', '', d)}"
UBOOT_ENTRYPOINT ?= "0x20080000"
UBOOT_DTB_LOADADDRESS ?= "0x23000000"

EXTRA_CMDLINE += "${@bb.utils.contains('DISTRO_FEATURES', 'systemd', 'fsck.repair=yes', '', d)}"
CMDLINE ?= "'quiet ${EXTRA_CMDLINE}'"

KCONFIG_MODE ?= "--alldefconfig"

KERNEL_MACH_PATH ?= "arch/arm/mach-${TCC_ARCH_FAMILY}"
TARGET_ARCH_ALIAS ?= "${TARGET_ARCH}"
TARGET_ARCH_ALIAS:aarch64 ?= "arm64"

require conf/machine/include/soc-family.inc

LINUX_VERSION ?= "5.10.177"
LINUXLIBCVERSION ?= "5.10"
LINUX_VERSION_EXTENSION = "-tcc"

TCC_BSP_FEATURES ?= ""

GLIBCVERSION ?= "2.35%"

FWDN_VERSION = "8"
DATA_PART_FSTYPE = "ext4"

STORAGE_SIZE ?= "${@oe.utils.conditional('BOOT_STORAGE', 'ufs', '${TCC_UFS_STORAGE_SIZE}', '${TCC_EMMC_STORAGE_SIZE}', d)}"
# Set maximum size of user rw parition. MB
MAX_DATA_SIZE ?= "1024"
# Set size of home rw parition. MB
HOME_DATA_SIZE ?= "500"

SPLASH_IMAGE ?= "${@oe.utils.conditional('BOOT_STORAGE', 'ufs', 'splash_1920x720x32_ufs.img', 'splash_1920x720x32.img', d)}"
SPLASH_IMAGE:tcc803x = "splash_1920x720x32_tcc803x.img"
```

## conf/machine/tcc7500-main.conf
```bitbake
#@TYPE: Machine
#@NAME: tcc7500 machine
#@DESCRIPTION: Machine configuration for the Telechips Evaluation Board

# don't reverse the order of 'DEFAULTTUNE' and 'require conf/machine/include/tune-cortexa53.inc'

require tcc750x.inc

SOC_FAMILY = "tcc750x:tcc7500-main"
UBOOT_DEVICE_TREE ??= "telechips/tcc750x/tcc7500-lpd4x321"
KERNEL_DEVICETREE ??= "telechips/tcc750x/tcc7500-lpd4x321.dtb"
```

## conf/machine/tcc8030-main.conf
```bitbake
#@TYPE: Machine
#@NAME: tcc8031p machine
#@DESCRIPTION: Machine configuration for the Telechips LCN Board

require tcc803x.inc

SOC_FAMILY = "tcc803x:tcc8030-main"

UBOOT_DEVICE_TREE ??= "telechips/tcc803x/tcc8030-lpd4321"
KERNEL_DEVICETREE ??= "telechips/tcc803x/tcc8030-lpd4321.dtb"

SUBCORE_DEPLOY_DIR ?= "${TOPDIR}/../tcc8030-sub/tmp/deploy/images/tcc8030-sub"
SUBCORE_BOOT_IMAGE_NAME ?= "Image-tcc8030-sub.bin"
SUBCORE_DTB_IMAGE_NAME ?= "tcc8030-subcore-lpd4321.dtb"
SUBCORE_ROOTFS_IMAGE_NAME ?= "telechips-subcore-image-tcc8030-sub.cpio"
```

## conf/machine/tcc8031p-main.conf
```bitbake
#@TYPE: Machine
#@NAME: tcc8031p machine
#@DESCRIPTION: Machine configuration for the Telechips LCN Board

require tcc803x.inc

SOC_FAMILY = "tcc803x:tcc8031p-main"

UBOOT_DEVICE_TREE ??= "telechips/tcc803x/tcc8031pe-lpd4321"
KERNEL_DEVICETREE ??= "telechips/tcc803x/tcc8031pe-lpd4321.dtb"

SUBCORE_DEPLOY_DIR ?= "${TOPDIR}/../tcc8031p-sub/tmp/deploy/images/tcc8031p-sub"
SUBCORE_BOOT_IMAGE_NAME ?= "Image-tcc8031p-sub.bin"
SUBCORE_DTB_IMAGE_NAME ?= "tcc8031pe-subcore-lpd4321.dtb"
SUBCORE_ROOTFS_IMAGE_NAME ?= "telechips-subcore-image-tcc8031p-sub.cpio"
```

## conf/machine/tcc803x.inc
```bitbake
#@TYPE: Machine
#@NAME: Telechips TCC803x Family
#@DESCRIPTION: Machine configuration for the Telechips EVB

# don't reverse the order of 'DEFAULTTUNE' and 'require conf/machine/include/tune-cortexa53.inc'
DEFAULTTUNE ?= "${@bb.utils.contains('ARCHITECTURE', 'arm', 'cortexa53-arm', 'cortexa53', d)}"
require conf/machine/include/arm/armv8a/tune-cortexa53.inc
require conf/machine/include/tune-cortexa53-arm.inc
require conf/machine/tcc-family.inc

GST_ARCH_FAMILY_NAME = "TCC_803x"
LCD_TYPE ??= "TIANMA"
LCD_WIDTH ??= "1920"
LCD_HEIGHT ??= "720"

SERIAL_CONSOLES = "115200;ttyAMA0"
KERNEL_CONSOLE = "ttyAMA0"

CONFLICT_MACHINE_FEATURES = "ufs"

EXTRA_IMAGEDEPENDS += "u-boot-tcc"

UBOOT_NAME ??= "u-boot"
UBOOT_SUFFIX = "rom"
UBOOT_MACHINE ??= "tcc803x_defconfig"
UBOOT_MAKE_TARGET = "tcc803x"

KBUILD_DEFCONFIG ??= "tcc803x_defconfig"
KERNEL_BASE_ADDR = "0x20000000"

UPDATE_BOOTLOADER_NAME = "${UBOOT_NAME}.${UBOOT_SUFFIX}"
UPDATE_KERNEL_NAME = "tc-boot.img"
UPDATE_ROOTFS_NAME = "${IMAGE_LINK_NAME}.${DEFAULT_IMAGE_FSTYPE}"
UPDATE_SNOR_NAME = "tcc803x_snor_boot.rom"
UPDATE_DTB_NAME = "${@d.getVar("KERNEL_DEVICETREE").split("/")[-1]}"

# GPU configuration
PREFERRED_PROVIDER_virtual/egl			= "telechips-egl"
PREFERRED_PROVIDER_virtual/libgles1		= "telechips-egl"
PREFERRED_PROVIDER_virtual/libgles2		= "telechips-egl"
PREFERRED_PROVIDER_virtual/mesa			= "telechips-egl"
PREFERRED_PROVIDER_libglapi			= "telechips-egl"
PREFERRED_PROVIDER_libgbm			= "telechips-egl"
PREFERRED_PROVIDER_libwayland-egl		= "telechips-egl"

# Telechips EVB UFS Size
TCC_UFS_STORAGE_SIZE ?= "31998345216"
# Telechips EVB eMMc Size
TCC_EMMC_STORAGE_SIZE ?= "7818182656"
```

## conf/machine/tcc8050-main.conf
```bitbake
#@TYPE: Machine
#@NAME: tcc8050 machine
#@DESCRIPTION: Machine configuration for the Telechips LCN Board

require tcc805x.inc

SOC_FAMILY = "tcc805x:tcc8050-main"

UBOOT_DEVICE_TREE ??= "telechips/tcc805x/tcc8050-lpd4x322-sv1.0"
KERNEL_DEVICETREE ??= "telechips/tcc805x/tcc8050-lpd4x322-sv1.0.dtb"

SUBCORE_DEPLOY_DIR ?= "${TOPDIR}/../tcc8050-sub/tmp/deploy/images/tcc8050-sub"
SUBCORE_BOOT_IMAGE_NAME ?= "tc-boot-tcc8050-sub.img"
SUBCORE_DTB_IMAGE_NAME ?= "tcc8050-subcore-lpd4x322-sv1.0.dtb"
SUBCORE_ROOTFS_IMAGE_NAME ?= "telechips-subcore-image-tcc8050-sub.ext4"
```

## conf/machine/tcc8053-main.conf
```bitbake
#@TYPE: Machine
#@NAME: tcc8053 machine
#@DESCRIPTION: Machine configuration for the Telechips LCN Board

require tcc805x.inc

SOC_FAMILY = "tcc805x:tcc8053-main"

UBOOT_DEVICE_TREE ??= "telechips/tcc805x/tcc8053-lpd4x322-sv1.0"
KERNEL_DEVICETREE ??= "telechips/tcc805x/tcc8053-lpd4x322-sv1.0.dtb"

SUBCORE_DEPLOY_DIR ?= "${TOPDIR}/../tcc8053-sub/tmp/deploy/images/tcc8053-sub"
SUBCORE_BOOT_IMAGE_NAME ?= "tc-boot-tcc8053-sub.img"
SUBCORE_DTB_IMAGE_NAME ?= "tcc8053-subcore-lpd4x322-sv1.0.dtb"
SUBCORE_ROOTFS_IMAGE_NAME ?= "telechips-subcore-image-tcc8053-sub.ext4"
```

## conf/machine/tcc8059-main.conf
```bitbake
#@TYPE: Machine
#@NAME: tcc8059 machine
#@DESCRIPTION: Machine configuration for the Telechips LCN Board

require tcc805x.inc

SOC_FAMILY = "tcc805x:tcc8059-main"

CONFLICT_MACHINE_FEATURES = "ufs"

UBOOT_DEVICE_TREE ??= "telechips/tcc805x/tcc8059-lpd4x321"
KERNEL_DEVICETREE ??= "telechips/tcc805x/tcc8059-lpd4x321.dtb"

SUBCORE_DEPLOY_DIR ?= "${TOPDIR}/../tcc8059-sub/tmp/deploy/images/tcc8059-sub"
SUBCORE_BOOT_IMAGE_NAME ?= "tc-boot-tcc8059-sub.img"
SUBCORE_DTB_IMAGE_NAME ?= "tcc8059-subcore-lpd4x321.dtb"
SUBCORE_ROOTFS_IMAGE_NAME ?= "telechips-subcore-image-tcc8059-sub.ext4"

UPDATE_SNOR_NAME = "tcc8059_snor.cs.rom"
```

## conf/machine/tcc805x.inc
```bitbake
#@TYPE: Machine
#@NAME: Telechips TCC805x Family
#@DESCRIPTION: Machine configuration for the Telechips EVM Board

require conf/machine/include/arm/armv8a/tune-cortexa72.inc
require conf/machine/tcc-family.inc

GST_ARCH_FAMILY_NAME = "TCC_805x"
LCD_TYPE ??= "TIANMA"
LCD_WIDTH ??= "1920"
LCD_HEIGHT ??= "720"

BOOT_STORAGE ??= "emmc"
SERIAL_CONSOLES = "115200;ttyAMA0"
KERNEL_CONSOLE = "ttyAMA0"

EXTRA_IMAGEDEPENDS += "u-boot-tcc"

UBOOT_NAME ??= "ca72_bl3"
UBOOT_SUFFIX = "rom"
UBOOT_MACHINE ??= "tcc805x_defconfig"
UBOOT_MAKE_TARGET = "tcc805x"

KBUILD_DEFCONFIG ??= "tcc805x_defconfig"
KERNEL_BASE_ADDR = "0x20000000"

UPDATE_BOOTLOADER_NAME = "${UBOOT_NAME}.${UBOOT_SUFFIX}"
UPDATE_KERNEL_NAME = "tc-boot-${MACHINE}.img"
UPDATE_ROOTFS_NAME = "${IMAGE_LINK_NAME}.${DEFAULT_IMAGE_FSTYPE}"
UPDATE_SNOR_NAME = "tcc8050_snor.cs.rom"
UPDATE_DTB_NAME = "${@d.getVar("KERNEL_DEVICETREE").split("/")[-1]}"

# GPU configuration
PREFERRED_PROVIDER_virtual/egl			= "${@bb.utils.contains('DISTRO_FEATURES', 'wayland', 'mesa', 'powervr', d)}"
PREFERRED_PROVIDER_virtual/libgles1		= "${@bb.utils.contains('DISTRO_FEATURES', 'wayland', 'mesa', 'powervr', d)}"
PREFERRED_PROVIDER_virtual/libgles2		= "${@bb.utils.contains('DISTRO_FEATURES', 'wayland', 'mesa', 'powervr', d)}"
PREFERRED_PROVIDER_virtual/mesa			= "${@bb.utils.contains('DISTRO_FEATURES', 'wayland', 'mesa', 'powervr', d)}"
PREFERRED_PROVIDER_libglapi				= "${@bb.utils.contains('DISTRO_FEATURES', 'wayland', 'mesa', '', d)}"
PREFERRED_PROVIDER_libgbm				= "${@bb.utils.contains('DISTRO_FEATURES', 'wayland', 'mesa', '', d)}"
PREFERRED_PROVIDER_libwayland-egl		= "${@bb.utils.contains('DISTRO_FEATURES', 'wayland', 'mesa', '', d)}"
PREFERRED_PROVIDER_vulkan-loader		= "powervr"

GPU_DRIVER_MODE ??= "${@bb.utils.contains_any("TCC_BSP_FEATURES", 'gpu-vz', 'guest', 'native', d)}"

# Telechips EVB UFS Size
TCC_UFS_STORAGE_SIZE ?= "31998345216"
# Telechips EVB eMMc Size
TCC_EMMC_STORAGE_SIZE ?= "7818182656"
```

## conf/machine/tcc8070-main.conf
```bitbake
#@TYPE: Machine
#@NAME: tcc8070 machine
#@DESCRIPTION: Machine configuration for the Telechips LCN Board

require tcc807x.inc

SOC_FAMILY = "tcc807x:tcc8070-main"

UBOOT_DEVICE_TREE ??= "telechips/tcc807x/tcc8070-lpd4x322"
KERNEL_DEVICETREE ??= "telechips/tcc807x/tcc8070-lpd4x322.dtb"

SUBCORE_DEPLOY_DIR ?= "${TOPDIR}/../tcc8070-sub/tmp/deploy/images/tcc8070-sub"
SUBCORE_BOOT_IMAGE_NAME ?= "tc-boot-tcc8070-sub.img"
SUBCORE_DTB_IMAGE_NAME ?= "tcc8070-subcore-lpd4x322.dtb"
SUBCORE_ROOTFS_IMAGE_NAME ?= "telechips-subcore-image-tcc8070-sub.ext4"
```

## conf/machine/tcc807x.inc
```bitbake
#@TYPE: Machine
#@NAME: Telechips TCC807x Family
#@DESCRIPTION: Machine configuration for the Telechips EVM Board

require conf/machine/include/arm/armv8-2a/tune-cortexa76-cortexa55.inc
require conf/machine/tcc-family.inc

GST_ARCH_FAMILY_NAME = "TCC_807x"
LCD_TYPE ??= "TIANMA"
LCD_WIDTH ??= "1920"
LCD_HEIGHT ??= "720"

BOOT_STORAGE ??= "emmc"
SERIAL_CONSOLES = "115200;ttyAMA0"
KERNEL_CONSOLE = "ttyAMA0"

EXTRA_IMAGEDEPENDS += "u-boot-tcc"

UBOOT_NAME ??= "ap0_bl3"
UBOOT_SUFFIX = "rom"
UBOOT_MACHINE ??= "tcc807x_defconfig"
UBOOT_MAKE_TARGET = "tcc807x"

KBUILD_DEFCONFIG ??= "tcc807x_defconfig"
KERNEL_BASE_ADDR = "0x20000000"

UPDATE_BOOTLOADER_NAME = "${UBOOT_NAME}.${UBOOT_SUFFIX}"
UPDATE_KERNEL_NAME = "tc-boot-${MACHINE}.img"
UPDATE_ROOTFS_NAME = "${IMAGE_LINK_NAME}.${DEFAULT_IMAGE_FSTYPE}"
UPDATE_DTB_NAME = "${@d.getVar("KERNEL_DEVICETREE").split("/")[-1]}"

# GPU configuration
PREFERRED_PROVIDER_virtual/egl			= "telechips-egl"
PREFERRED_PROVIDER_virtual/libgles1		= "telechips-egl"
PREFERRED_PROVIDER_virtual/libgles2		= "telechips-egl"
PREFERRED_PROVIDER_virtual/mesa			= "telechips-egl"
PREFERRED_PROVIDER_libglapi				= "telechips-egl"
PREFERRED_PROVIDER_libgbm				= "telechips-egl"
PREFERRED_PROVIDER_libwayland-egl		= "telechips-egl"

# Telechips EVB UFS Size
TCC_UFS_STORAGE_SIZE ?= "63988301824"
# Telechips EVB eMMc Size
TCC_EMMC_STORAGE_SIZE ?= "31268536320"
```

## conf/machine/tcc897x.inc
```bitbake
#@TYPE: Machine
#@NAME: Telechips TCC897x Family
#@DESCRIPTION: Machine configuration for the Telechips EVM Board

require conf/machine/include/arm/armv7a/tune-cortexa7.inc
require tcc-family.inc

LK_PROJECT_NAME = "tcc897x_evm_emmc"
LK_TARGET_NAME = "tcc897x_evm"
LK_RULE_NAME = "tcc8970_evm_d3_08x4_sv0.1.mk"
GST_ARCH_FAMILY_NAME = "TCC_897x"
LCD_WIDTH ??= "1024"
LCD_HEIGHT ??= "600"

SERIAL_CONSOLE = "115200;ttyS0"
KERNEL_CONSOLE = "ttyS0"

CONFLICT_MACHINE_FEATURES = "ufs"

EXTRA_IMAGEDEPENDS += "lk-dt"

LINUX_VERSION = "5.4.254"
LINUXLIBCVERSION = "5.4"

# GPU configuration
PREFERRED_PROVIDER_virtual/egl      = "telechips-egl"
PREFERRED_PROVIDER_virtual/libgles1 = "telechips-egl"
PREFERRED_PROVIDER_virtual/libgles2 = "telechips-egl"
PREFERRED_PROVIDER_virtual/mesa     = "telechips-egl"
PREFERRED_PROVIDER_virtual/libgl    = "telechips-egl"
PREFERRED_PROVIDER_libglapi         = "telechips-egl"
PREFERRED_PROVIDER_libgbm           = "telechips-egl"
PREFERRED_PROVIDER_libwayland-egl   = "telechips-egl"

FWDN_VERSION = "7"
DATA_PART_FSTYPE = "vfat"

SKIP_RECIPE[boot-firmware] = "not buildable with tcc897x"
```
